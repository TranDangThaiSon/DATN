## bh1750_driver/Config.in
```kconfig
config BR2_PACKAGE_BH1750_DRIVER
    bool "bh1750_driver"
    depends on BR2_LINUX_KERNEL
    help
      Driver for BH1750 Light Sensor via I2C.
```

## dht11_driver/Config.in
```kconfig
config BR2_PACKAGE_DHT11_DRIVER
	bool "dht11_driver"
	depends on BR2_LINUX_KERNEL
	help
	  Driver for DHT11 sensor on Raspberry Pi 4.
```

## monitor_qt/Config.in
```kconfig
config BR2_PACKAGE_MONITOR_QT
    bool "monitor_qt"
    depends on BR2_PACKAGE_QT5
    select BR2_PACKAGE_QT5BASE_WIDGETS
    select BR2_PACKAGE_QT5BASE_FONTCONFIG
    select BR2_PACKAGE_QT5BASE_CONCURRENT
    select BR2_PACKAGE_QT5BASE_PNG # Cần thiết nếu có icon/ảnh
    select BR2_PACKAGE_LIBCURL
    select BR2_PACKAGE_TENSORFLOW_LITE
    help
      Qt Monitoring Application with Edge Impulse TFLite model.
      Displays Temp, Humid, Lux and AI Prediction.
```
